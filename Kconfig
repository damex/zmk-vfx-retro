## Kconfig
```kconfig
# Copyright 2026 Roman Kuzmitskii (@damex)
# SPDX-License-Identifier: MIT

menuconfig VFX_RETRO
    bool "Retro pixel-art status screen"
    depends on ZMK_DISPLAY
    select LV_USE_CANVAS
    select LV_USE_LABEL
    help
      Pixel-art status screen for ZMK displays.

if VFX_RETRO

config VFX_RETRO_PANEL_WIDTH
    int "Panel width (px)"
    default 160

config VFX_RETRO_PANEL_HEIGHT
    int "Panel height (px)"
    default 68

choice VFX_RETRO_STYLE
    prompt "Sprite style"
    default VFX_RETRO_STYLE_PACMAN

config VFX_RETRO_STYLE_PACMAN
    bool "Pac-Man"

endchoice

choice VFX_RETRO_FONT
    prompt "Text font"
    default VFX_RETRO_FONT_UNSCII_8

config VFX_RETRO_FONT_UNSCII_8
    bool "UNSCII 8 (pixel, small)"
    select LV_FONT_UNSCII_8

config VFX_RETRO_FONT_UNSCII_16
    bool "UNSCII 16 (pixel, large)"
    select LV_FONT_UNSCII_16

endchoice

config VFX_RETRO_REFRESH_MS
    int "Refresh interval (ms)"
    default 1000
    help
      Status screen redraw period.

endif # VFX_RETRO
```
